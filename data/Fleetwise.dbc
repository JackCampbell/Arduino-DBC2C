VERSION "1.0"

NS_ :

BS_:

BU_:

BO_ 2024 OBD2: 8 Vector__XXX
  SG_ S1_PID_0C_EngineSpeed m12 : 31|16@0+ (0.25,0) [0|16383.75] "rpm" Vector__XXX
  SG_ S1_PID_0D_VehicleSpeed m13 : 31|8@0+ (1,0) [0|255] "km/h" Vector__XXX
  SG_ S1 m1M : 23|8@0+ (1,0) [0|255] "" Vector__XXX
  SG_ Service M : 11|4@0+ (1,0) [0|15] "" Vector__XXX

BA_DEF_ BO_ "GenMsgCycleTime" INT 0 10000;
BA_DEF_DEF_ "GenMsgCycleTime" 0;

BA_ "GenMsgCycleTime" BO_ 2024 50;
BA_ "GenMsgCycleTime" BO_ 2025 50;

SG_MUL_VAL_ 2024 S1_PID_0C_EngineSpeed S1 12-12;
SG_MUL_VAL_ 2024 S1_PID_0D_VehicleSpeed S1 13-13;
SG_MUL_VAL_ 2024 S1 Service 1-1
