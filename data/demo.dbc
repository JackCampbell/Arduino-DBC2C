VERSION ""

NS_ :

BS_:

BU_: IO System

BO_ 2364540158 EEC1: 8 IO
  SG_ EngineSpeed: 24|16@1+ (0.125,0) [0|8031.8682] "rpm" Vector__XXX

BO_ 2364540159 EEC1: 8 IO
  SG_ EngineSpeed: 24|16@0+ (0.125,0) [0|8031.8682] "rpm" Vector__XXX

BO_ 2566844926 CCVS1: 8 IO
  SG_ WheelBasedVehicleSpeed: 8|16@1+ (0.00390625,0) [0|250.99599] "km/h" Vector__XXX

VAL_TABLE_ SpdLmtrSttngTyp 0 "Manual" 1 "Auto";
VAL_TABLE_ StartStop 0 "Off" 1 "Trigger" 2 "On";
VAL_ 2364540159 EngineSpeed 0 "None";
CM_ "Hello world
";
CM_ BU_ IO "Device Input / Output";
CM_ BU_ System "Comment";
CM_ SG_ 2364540158 EngineSpeed "Actual engine speed which is calculated over a minimum crankshaft angle of 720 degrees divided by the number of cylinders.";
CM_ SG_ 2566844926 WheelBasedVehicleSpeed "Wheel-Based Vehicle Speed: Speed of the vehicle as calculated from wheel or tailshaft speed.";
BA_DEF_ SG_ "SPN" STRING;
BA_DEF_  "DatabaseVersion" STRING;
BA_DEF_  "BusType" STRING;
BA_DEF_  "ProtocolType" STRING;
BA_DEF_  "DatabaseCompiler" STRING;
BA_DEF_DEF_ "SPN" "";
BA_DEF_DEF_ "DatabaseVersion" "";
BA_DEF_DEF_ "BusType" "";
BA_DEF_DEF_ "ProtocolType" "";
BA_DEF_DEF_ "DatabaseCompiler" "";
BA_ "BusType" "CAN";
BA_ "ProtocolType" "J1939";
BA_ "DatabaseVersion" "1.0.0";
BA_ "DatabaseCompiler" "CSS ELECTRONICS (WWW.CSSELECTRONICS.COM)";
BA_ "SPN" SG_ 2364540158 EngineSpeed "190";
BA_ "SPN" SG_ 2566844926 WheelBasedVehicleSpeed "84";
